## Kconfig
```kconfig
menu "Target option"
    config TARGET_BOARD
        string
        default "pico"
        prompt "Target board name"

    config TARGET_ARCH
        string
        default "m0plus"
        prompt "Target architecture name"

endmenu

menu "IPC option"
    config IPC_CHANNEL_COUNT
        int
        default 16
        prompt "IPC channel count"

    config IPC_CHANNEL_LENGTH
        int
        default 16
        prompt "IPC channel length"

    config IPC_MESSAGE_SIZE
        int
        default 32
        prompt "IPC message size"
endmenu

menu "Task option"
    config TASK_NAME_SIZE
        int
        default 16
        prompt "Task name size"
endmenu
```

## src/arch/Kconfig
```kconfig
choice
    prompt "Architecture"
    default ARM

config ARM
    bool "ARM architecture"

config X86_64
    bool "x86_64 architecture"

endchoice

source "src/arch/arm/Kconfig"
source "src/arch/x86_64/Kconfig"
```

## src/arch/arm/Kconfig
```kconfig
menu "ARM architecture"
    depends on ARM

config TARGET_ARCH
    string
    default "arm"

choice
    prompt "Target select"
    default ARCH_RP2040

config ARCH_RP2040
    bool "RP2040"

config ARCH_BCM283X
    bool "bcm283x"

endchoice

endmenu

source "src/arch/arm/rp2040/Kconfig"
source "src/arch/arm/bcm283x/Kconfig"
```

## src/arch/x86_64/Kconfig
```kconfig
if X86_64

config TARGET_ARCH
    string
    default "x86_64"

config TARGET_CC
    string
    default "x86_64-elf-gcc"

config TARGET_AS
    string
    default "x86_64-elf-as"

config TARGET_LD
    string
    default "x86_64-elf-ld"

config NO_BOARD
    bool
    default y

endif
```

## src/board/Kconfig
```kconfig
choice
    prompt "Board"
    default BOARD_PICO

source "src/board/pico/Kconfig"
source "src/board/rpizero/Kconfig"

endchoice
```

## src/board/pico/Kconfig
```kconfig
config BOARD_PICO
    bool "Support Raspberry PI pico"
    depends on ARCH_RP2040

if BOARD_PICO

    config TARGET_BOARD
        string
        default "pico"

endif
```

## src/board/rpizero/Kconfig
```kconfig
config BOARD_RPIZERO
    bool "Support Raspberry PI ZERO"
    depends on ARCH_BCM283X

if BOARD_RPIZERO

    config TARGET_BOARD
        string
        default "rpizero"

endif
```
